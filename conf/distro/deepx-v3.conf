## conf/machine/v3-evb.conf
```bitbake
#@TYPE: Machine
#@NAME: v3-evb machine
#@DESCRIPTION: Machine configuration for DEEPX V3 64-bit

require conf/machine/include/v3.inc

# Trusted-Firmware M
TFM_DDR_MTS = "6400"
TFM_BL2_LOG_LEVEL = "4"
TFM_SECURE_LOG_LEVEL = "2"

# Trusted-Firmware A
TFA_BOARD = "evb"
TFA_DEBUG = "1"
TFA_LOG_LEVEL = "40"

# u-boot
UBOOT_MACHINE = "v3_evb_defconfig"

# Linux kernel
KBUILD_DEFCONFIG = "v3_evb_defconfig"
KERNEL_DEVICETREE = "deepx/v3-evb.dtb"
```

## conf/machine/v3-sort.conf
```bitbake
#@TYPE: Machine
#@NAME: v3-sort machine
#@DESCRIPTION: Machine configuration for DEEPX V3 64-bit

require conf/machine/include/v3.inc

# Trusted-Firmware M
TFM_DDR_MTS = "6400"
TFM_BL2_LOG_LEVEL = "4"
TFM_SECURE_LOG_LEVEL = "2"

# Trusted-Firmware A
TFA_BOARD = "sort"
TFA_DEBUG = "1"
TFA_LOG_LEVEL = "40"

# u-boot
UBOOT_MACHINE = "v3_sort_defconfig"

# Linux kernel
KBUILD_DEFCONFIG = "v3_sort_defconfig"
KERNEL_DEVICETREE = "deepx/v3-sort.dtb"

# WIC configuration
WKS_FILE = "deepx-v3-mmc.wks"

IMAGE_BOOTFS_WIC_DISK = "mmcblk2"
IMAGE_BOOTFS_WIC_SIZE = "64M"

IMAGE_ROOTFS_WIC_DISK = "mmcblk2"
IMAGE_ROOTFS_WIC_SIZE = "4G"
IMAGE_ROOTFS_EXTRA_SPACE = "0"

# Boot partition files
IMAGE_BOOT_FILES = "${KERNEL_IMAGETYPE} linux.dtb"
```
